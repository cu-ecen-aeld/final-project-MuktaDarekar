## meta-capture/conf/layer.conf
```bitbake
# We have a conf and classes directory, add to BBPATH
BBPATH := "${BBPATH}:${LAYERDIR}" 

# We have recipes-* directories, add to BBFILES
BBFILES += "${LAYERDIR}/recipes-*/*/*.bb \
            ${LAYERDIR}/recipes-*/*/*.bbappend"

BBFILE_COLLECTIONS += "meta-capture"
BBFILE_PATTERN_meta-capture = "^${LAYERDIR}/"
BBFILE_PRIORITY_meta-capture = "6"

LAYERDEPENDS_capture = "core"
LAYERSERIES_COMPAT_meta-capture = "honister"
```
